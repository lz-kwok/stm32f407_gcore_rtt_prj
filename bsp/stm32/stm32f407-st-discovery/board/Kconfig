## bsp/stm32/stm32f407-st-discovery/board/Kconfig
```kconfig
menu "Hardware Drivers Config"

config SOC_STM32F407VG
    bool
    select SOC_SERIES_STM32F4
    default y

menu "Onboard Peripheral Drivers"
	config PHY_USING_LAN8720A
        bool
		
	config BSP_USING_ETH
        bool "Enable Ethernet"
        select RT_USING_LWIP
        select PHY_USING_LAN8720A
        default n
		
	menuconfig BSP_USING_GPRS
        bool "Enable GPRS"
        default n
        select RT_USING_GPRS
        if BSP_USING_GPRS
            config BSP_USING_AIR202
                bool "Enable AIR202 For GPRS"
                default n

            config BSP_USING_SIM800C
                bool "Enable SIM800C For GPRS"
                default n
        endif
endmenu

menu "On-chip Peripheral Drivers"

    config BSP_USING_GPIO
        bool "Enable GPIO"
        select RT_USING_PIN
        default y

    menuconfig BSP_USING_UART
        bool "Enable UART"
        default y
        select RT_USING_SERIAL
        if BSP_USING_UART
            config BSP_USING_UART1
                bool "Enable UART1"
                default y

            config BSP_UART1_RX_USING_DMA
                bool "Enable UART1 RX DMA"
                depends on BSP_USING_UART1 && RT_SERIAL_USING_DMA
                default n
			
			config BSP_USING_UART2
                bool "Enable UART2"
                default n
			
			config BSP_USING_UART3
                bool "Enable UART3"
                default n
			
			config BSP_UART3_RX_USING_DMA
                bool "Enable UART3 RX DMA"
                depends on BSP_USING_UART3 && RT_SERIAL_USING_DMA
                default n
        endif

    menuconfig BSP_USING_SPI
        bool "Enable SPI BUS"
        default n
        select RT_USING_SPI
        if BSP_USING_SPI
            config BSP_USING_SPI1
                bool "Enable SPI1 BUS"
                default n

            config BSP_SPI1_TX_USING_DMA
                bool "Enable SPI1 TX DMA"
                depends on BSP_USING_SPI1
                default n
                
            config BSP_SPI1_RX_USING_DMA
                bool "Enable SPI1 RX DMA"
                depends on BSP_USING_SPI1
                select BSP_SPI1_TX_USING_DMA
                default n
        endif

    menuconfig BSP_USING_I2C1
        bool "Enable I2C1 BUS (software simulation)"
        default n
        select RT_USING_I2C
        select RT_USING_I2C_BITOPS
        select RT_USING_PIN
        if BSP_USING_I2C1
            config BSP_I2C1_SCL_PIN
                int "i2c1 scl pin number"
                range 1 216
                default 24
            config BSP_I2C1_SDA_PIN
                int "I2C1 sda pin number"
                range 1 216
                default 25
        endif
		
	menuconfig BSP_USING_USBD_FS
        bool "Enable USB"
        default n
        if BSP_USING_USBD_FS
            config BSP_USING_USBD_FS_DEVICE
                bool "Enable OTGFS as USB device"
				select RT_USING_USB_DEVICE
                default n

            config BSP_USING_USBD_FS_HOST
                bool "Enable OTGFS as USB host"
                select RT_USING_USB_HOST
                default n
        endif

	config BSP_USING_FMC
        bool "Enable FMC"
        default n

    source "../libraries/HAL_Drivers/Kconfig"
    
endmenu

menu "Board extended module Drivers"

endmenu
 
endmenu
```

## components/gui/Kconfig
```kconfig
menu "GUI Features"

config RT_USING_NANOGUI
    bool "Support Desktop&Digital_Tube"
    default n

endmenu
```

## components/rl-arm/Kconfig
```kconfig
menu "ARM RL Components"

config RT_USING_RL_ARM
    bool "Using RL-ARM assembly"
    default n
    help
        The RL-ARM is a third-part assembly

if RT_USING_RL_ARM
    config RT_USING_RL_FLASHFS
        bool "Using RL-FlashFS"
        default n

    config RT_USING_RL_TCPnet
        bool "Using RL-TCPnet"
        default n
endif

endmenu
```
